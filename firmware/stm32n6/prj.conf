## CMakeLists.txt
```
cmake_minimum_required(VERSION 3.20.0)

find_package(Zephyr REQUIRED HINTS $ENV{ZEPHYR_BASE})
project(stm32n6_app)

target_sources(app PRIVATE
    src/main_measurements.c
    src/npu_stub.c
    src/control.c
)

target_include_directories(app PRIVATE
    include
)
```

## west.yml
```
manifest:
  remotes:
    - name: zephyrproject-rtos
      url-base: https://github.com/zephyrproject-rtos
  projects:
    - name: zephyr
      remote: zephyrproject-rtos
      revision: v3.5.0
      import: true
  self:
    path: firmware/stm32n6
```

## prj.conf
```kconfig
CONFIG_PRINTK=y
CONFIG_CONSOLE=y
CONFIG_UART_CONSOLE=y

# Logging
CONFIG_LOG=y
CONFIG_LOG_DEFAULT_LEVEL=3

# GPIO
CONFIG_GPIO=y

# SPI (for NPU interface)
CONFIG_SPI=y

# Memory
CONFIG_HEAP_MEM_POOL_SIZE=32768

# Application specific
CONFIG_MAIN_STACK_SIZE=4096
```

## src/main.c
```c
/*
 * STM32N6 Application - Main Entry Point
 * Control firmware with NPU stub interface
 */

#include <zephyr/kernel.h>
#include <zephyr/device.h>
#include <zephyr/drivers/gpio.h>
#include <zephyr/logging/log.h>

#include "npu_stub.h"
#include "control.h"

LOG_MODULE_REGISTER(main, LOG_LEVEL_INF);

#define LED0_NODE DT_ALIAS(led0)

#if DT_NODE_HAS_STATUS(LED0_NODE, okay)
static const struct gpio_dt_spec led = GPIO_DT_SPEC_GET(LED0_NODE, gpios);
#else
#error "Unsupported board: led0 devicetree alias is not defined"
#endif

int main(void)
{
    int ret;

    LOG_INF("STM32N6 Application Starting...");
    LOG_INF("Build: %s %s", __DATE__, __TIME__);

    /* Initialize LED */
    if (!gpio_is_ready_dt(&led)) {
        LOG_ERR("LED device not ready");
        return -ENODEV;
    }

    ret = gpio_pin_configure_dt(&led, GPIO_OUTPUT_ACTIVE);
    if (ret < 0) {
        LOG_ERR("Failed to configure LED pin");
        return ret;
    }

    /* Initialize NPU stub */
    ret = npu_stub_init();
    if (ret < 0) {
        LOG_ERR("NPU stub initialization failed: %d", ret);
        return ret;
    }

    /* Initialize control subsystem */
    ret = control_init();
    if (ret < 0) {
        LOG_ERR("Control initialization failed: %d", ret);
        return ret;
    }

    LOG_INF("System initialized successfully");

    /* Main loop */
    while (1) {
        gpio_pin_toggle_dt(&led);
        
        /* Process control tasks */
        control_process();
        
        k_msleep(1000);
    }

    return 0;
}
```

## include/npu_stub.h
```c
/*
 * NPU Stub Interface Header
 */

#ifndef NPU_STUB_H
#define NPU_STUB_H

#include <stdint.h>
#include <stddef.h>
#include <stdbool.h>

/**
 * @brief Initialize the NPU stub interface
 * @return 0 on success, negative errno on failure
 */
int npu_stub_init(void);

/**
 * @brief Run inference on the NPU
 * @param input_data Pointer to input data buffer
 * @param input_size Size of input data in bytes
 * @param output_data Pointer to output data buffer
 * @param output_size Size of output buffer in bytes
 * @return 0 on success, negative errno on failure
 */
int npu_stub_inference(const uint8_t *input_data, size_t input_size,
                       uint8_t *output_data, size_t output_size);

/**
 * @brief Load a model onto the NPU
 * @param model_name Name of the model to load
 * @return 0 on success, negative errno on failure
 */
int npu_stub_load_model(const char *model_name);

/**
 * @brief Check if NPU is ready
 * @return true if NPU is ready, false otherwise
 */
bool npu_stub_is_ready(void);

#endif /* NPU_STUB_H */
```

## src/control.c
```c
/*
 * Control Subsystem
 * Main control logic and state management
 */

#include <zephyr/kernel.h>
#include <zephyr/logging/log.h>

#include "control.h"
#include "npu_stub.h"

LOG_MODULE_REGISTER(control, LOG_LEVEL_DBG);

static struct {
    bool initialized;
    uint32_t tick_count;
    enum {
        STATE_IDLE,
        STATE_RUNNING,
        STATE_ERROR
    } state;
} control_ctx;

int control_init(void)
{
    LOG_INF("Initializing control subsystem");
    
    control_ctx.initialized = true;
    control_ctx.tick_count = 0;
    control_ctx.state = STATE_IDLE;
    
    LOG_INF("Control subsystem initialized");
    return 0;
}

void control_process(void)
{
    if (!control_ctx.initialized) {
        return;
    }

    control_ctx.tick_count++;

    switch (control_ctx.state) {
    case STATE_IDLE:
        if (npu_stub_is_ready()) {
            control_ctx.state = STATE_RUNNING;
            LOG_INF("Transitioning to RUNNING state");
        }
        break;

    case STATE_RUNNING:
        /* Periodic processing */
        if (control_ctx.tick_count % 10 == 0) {
            LOG_DBG("Control tick: %u", control_ctx.tick_count);
        }
        break;

    case STATE_ERROR:
        LOG_ERR("System in ERROR state");
        break;
    }
}

int control_get_status(void)
{
    return control_ctx.state;
}

void control_loop_run(void)
{
    /* This function is called from main_measurements.c */
    /* The actual control loop is in main_measurements.c */
}
```

## src/npu_stub.c
```c
/*
 * NPU Stub Interface
 * Simulates NPU communication for testing
 */

#include <zephyr/kernel.h>
#include <zephyr/logging/log.h>
#include <zephyr/drivers/spi.h>

#include "npu_stub.h"

LOG_MODULE_REGISTER(npu_stub, LOG_LEVEL_DBG);

static bool npu_initialized = false;

int npu_stub_init(void)
{
    LOG_INF("Initializing NPU stub interface");
    
    /* TODO: Initialize SPI communication to NPU */
    
    npu_initialized = true;
    LOG_INF("NPU stub initialized");
    
    return 0;
}

int npu_stub_inference(const uint8_t *input_data, size_t input_size,
                       uint8_t *output_data, size_t output_size)
{
    if (!npu_initialized) {
        LOG_ERR("NPU not initialized");
        return -ENODEV;
    }

    LOG_DBG("Running inference: input_size=%zu, output_size=%zu", 
            input_size, output_size);

    /* TODO: Implement actual NPU communication */
    /* For now, return dummy data */
    if (output_data && output_size > 0) {
        memset(output_data, 0xAA, output_size);
    }

    return 0;
}

int npu_stub_load_model(const char *model_name)
{
    if (!npu_initialized) {
        LOG_ERR("NPU not initialized");
        return -ENODEV;
    }

    LOG_INF("Loading model: %s", model_name);
    
    /* TODO: Implement model loading */
    
    return 0;
}

bool npu_stub_is_ready(void)
{
    return npu_initialized;
}
```
